/* keymap parsed by `just draw`: the chocofi's configuration, with all the
optional features enabled */
#define WIRELESS 1
#define ALPHA_23332 1
#define MOUSE_KEYS 1

/* source the main keymap */
#include "base.keymap"
