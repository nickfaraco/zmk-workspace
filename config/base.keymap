#include <behaviors.dtsi>
#include <dt-bindings/zmk/keys.h>
#include <dt-bindings/zmk/outputs.h>
#include <dt-bindings/zmk/bt.h>
#include <behaviors/num_word.dtsi> // requires auto-layer module

// behavior and key position helpers
#include "zmk-helpers/helper.h"
#include "zmk-helpers/key-labels/36.h"

// unicode
#include <behaviors/unicode.dtsi>

// layers ID definition
#define BASE 0
#define BASE_WIN 1
#define NUM 2
#define NUMF 3
#define NAV 4
#define NAVW 5
#define GAME 6
#define ADJ 7
#define MSE 8

#define xxx &none
#define ___ &trans

// tapping term definition
#define TAP_TERM_MS 200
#define QUICK_TAP_MS 125


#include "common/os.dtsi"
#include "common/macros.dtsi"
#include "common/combos.dtsi"
#include "common/leader.dtsi"
#include "common/extra_keys.h"
#if WIRELESS
    // clear the current profile's pairing: double-tap only
    ZMK_TAP_DANCE(bt_clr,
        tapping-term-ms = <TAP_TERM_MS>;
        bindings = <&none>, <&bt BT_CLR>;
    )
    #define BTL1  &bt_clr      &bt BT_SEL 2  &bt BT_SEL 1  &bt BT_SEL 0
    #define BTL2  xxx          &bt BT_SEL 4  &bt BT_SEL 3  &out OUT_TOG
#else
    #define BTL1  xxx   xxx   xxx   xxx
    #define BTL2  xxx   xxx   xxx   xxx
#endif

#ifdef MOUSE_KEYS
    #include "common/mouse.dtsi"
#endif

// macros definition
#define hyper LG(LC(LS(LALT)))

// tune sticky key
&sk {
    release-after-ms = <1000>;
    quick-release;
};

// sticky layer config
&sl {
    release-after-ms = <700>;
};

// caps word settings
&caps_word {
    continue-list = <UNDERSCORE MINUS BSPC>;
};

// KEYS_L, KEYS_R and THUMBS are provided by zmk-helpers/key-labels/36.h

/* left-hand HRMs */
ZMK_HOLD_TAP(hml,
    flavor = "balanced";
    tapping-term-ms = <280>;
    quick-tap-ms = <175>;                // repeat on tap-into-hold
    require-prior-idle-ms = <150>;
    bindings = <&kp>, <&kp>;
    hold-trigger-key-positions = <KEYS_R THUMBS>;
    hold-trigger-on-release;             // delay positional check until key-release
)

/* right-hand HRMs */
ZMK_HOLD_TAP(hmr,
    flavor = "balanced";
    tapping-term-ms = <280>;
    quick-tap-ms = <175>;                // repeat on tap-into-hold
    require-prior-idle-ms = <150>;
    bindings = <&kp>, <&kp>;
    hold-trigger-key-positions = <KEYS_L THUMBS>;
    hold-trigger-on-release;             // delay positional check until key-release
)

/* hyper-key mod-tap */
ZMK_HOLD_TAP(hmt,
    flavor = "balanced";
    tapping-term-ms = <280>;
    quick-tap-ms = <175>;                // repeat on tap-into-hold
    require-prior-idle-ms = <150>;
    bindings = <&kp>, <&kp>;
)

/* BEHAVIORS */

// tap: sticky-shift | lshft + tap: caps-word | hold: set in keymap (HYPER)
ZMK_MOD_MORPH(ss_cw,
    bindings = <&sk RSHFT>, <&caps_word>;
    mods = <(MOD_LSFT|MOD_RSFT)>;
)
ZMK_HOLD_TAP(lt_shft,
    tapping-term-ms = <TAP_TERM_MS>;
    quick-tap-ms = <QUICK_TAP_MS>;
    flavor = "balanced";
    bindings = <&mo>, <&ss_cw>;
)

// tap: space | shft + tap: dot -> space -> sticky shift | hold: activate layer
ZMK_MOD_MORPH(spc_morph,
    bindings = <&kp SPACE>, <&dot_spc>;
    mods = <(MOD_RSFT)>;
)
ZMK_HOLD_TAP( lt_spc,
    tapping-term-ms = <TAP_TERM_MS>;
    quick-tap-ms = <QUICK_TAP_MS>;
    flavor = "balanced";
    bindings = <&mo>, <&spc_morph>;
)

// Currency: tap: $ | shift + tap: € (unicode, follows the OS layer)
ZMK_MOD_MORPH(curr,
    bindings = <&kp DLLR>, <&uc 0x20AC 0x20AC>;
    mods = <(MOD_LSFT|MOD_RSFT)>;
)

// Tap Dances
ZMK_TAP_DANCE(screenshot,
    // single-tap: area selector, double-tap: open screenshot app, triple-tap: full-screen
    tapping-term-ms = <TAP_TERM_MS>;
    bindings = <&kp LG(LS(N4))>, <&kp LG(LS(N5))>, <&kp LG(LS(N3))>;
)
ZMK_TAP_DANCE(lockscr,
    tapping-term-ms = <TAP_TERM_MS>;
    bindings = <&none>, <&kp LC(LG(Q))>;
)
ZMK_TAP_DANCE(lockscr_win,
    tapping-term-ms = <TAP_TERM_MS>;
    bindings = <&none>, <&kp LG(L)>;
)
// quit app: double-tap only
ZMK_TAP_DANCE(quit,
    tapping-term-ms = <TAP_TERM_MS>;
    bindings = <&none>, <&kp LG(Q)>;
)
ZMK_TAP_DANCE(quit_win,
    tapping-term-ms = <TAP_TERM_MS>;
    bindings = <&none>, <&kp LA(F4)>;
)


/* Nav cluster */

// long-tap action on hold, short-tap action on all interrupts
#define MT_CORE \
    flavor = "tap-preferred"; \
    tapping-term-ms = <220>; \
    quick-tap-ms = <220>; \
    hold-trigger-key-positions = <0>;

&mt { MT_CORE };
ZMK_HOLD_TAP(mt_bol, bindings = <&masked_bol>, <&kp>; MT_CORE)
ZMK_HOLD_TAP(mt_eol, bindings = <&masked_eol>, <&kp>; MT_CORE)
ZMK_HOLD_TAP(mt_home, bindings = <&masked_home>, <&kp>; MT_CORE)
ZMK_HOLD_TAP(mt_end, bindings = <&masked_end>, <&kp>; MT_CORE)

// macOS (Nav)
#define NAV_LEFT    &mt_bol 0    LEFT  // tap: left  | long-tap: beginning of line
#define NAV_RIGHT   &mt_eol 0    RIGHT // tap: right | long-tap: end       of line
#define NAV_UP      &mt LG(UP)   UP    // tap: up    | long-tap: beginning of document
#define NAV_DOWN    &mt LG(DOWN) DOWN  // tap: down  | long-tap: end       of document
// Linux/Windows (Nav_W)
#define NAV_LEFT_W  &mt_home 0   LEFT
#define NAV_RIGHT_W &mt_end 0    RIGHT
#define NAV_UP_W    &mt LC(HOME) UP
#define NAV_DOWN_W  &mt LC(END)  DOWN

// mask the word-jump modifier when holding left/right, so that a long-tap
// inside a word jump doesn't become a jump to beginning/end of document (PC)
// or a tab switch (macOS)
#define MASK_MODS(NAME, MODS, BINDING) \
    ZMK_MOD_MORPH(NAME, \
        bindings = <BINDING>, <BINDING>; \
        mods = <MODS>; \
    )
MASK_MODS(masked_bol,  (MOD_LALT), &kp LG(LEFT))
MASK_MODS(masked_eol,  (MOD_LALT), &kp LG(RIGHT))
MASK_MODS(masked_home, (MOD_LCTL), &kp HOME)
MASK_MODS(masked_end,  (MOD_LCTL), &kp END)


// Smart-num layer
// tap: num-word | double-tap: sticky num-layer | hold: num-layer
#define SMART_NUM &smart_num NUMF 0
ZMK_HOLD_TAP(smart_num,
    tapping-term-ms = <TAP_TERM_MS>;
    quick-tap-ms = <QUICK_TAP_MS>;
    flavor = "balanced";
    bindings = <&mo>, <&num_dance>;
)
ZMK_TAP_DANCE(num_dance,
    tapping-term-ms = <TAP_TERM_MS>;
    bindings = <&num_word NUM>, <&sl NUM>;
)


// Alt+Tab swapper
ZMK_TRI_STATE(swapper,
    bindings = <&kt LGUI>, <&kp TAB>, <&kt LGUI>;
    ignored-key-positions = <LB3>;
)
ZMK_TRI_STATE(swapper_win,
    bindings = <&kt LALT>, <&kp TAB>, <&kt LALT>;
    ignored-key-positions = <LB3>;
)


// Convenience Mod-Morphs
// Morphs whose shifted output is itself a shifted keycode keep shift held
// instead of masking it: masking swaps right shift for the keycode's implicit
// left shift within one HID report, which iPadOS reads as unshifted.
ZMK_MOD_MORPH(esc_kcancel,
    bindings = <&kp ESCAPE>, <&kp K_CANCEL>;
    mods = <(MOD_LSFT|MOD_RSFT)>;
)
ZMK_MOD_MORPH(dot_colon,
    bindings = <&kp DOT>, <&kp COLON>;
    mods = <(MOD_LSFT|MOD_RSFT)>;
    keep-mods = <(MOD_LSFT|MOD_RSFT)>;
)
ZMK_MOD_MORPH(comma_semi,
    bindings = <&kp COMMA>, <&kp SEMICOLON>;
    mods = <(MOD_LSFT|MOD_RSFT)>;
)
ZMK_MOD_MORPH(single_to_doublequote,
    bindings = <&kp SINGLE_QUOTE>, <&kp DOUBLE_QUOTES>;
    mods = <(MOD_LSFT|MOD_RSFT)>;
    keep-mods = <(MOD_LSFT|MOD_RSFT)>;
)
ZMK_MOD_MORPH(lpar_to_lessthan,
    bindings = <&kp LPAR>, <&kp LT>;
    mods = <(MOD_LSFT|MOD_RSFT)>;
    keep-mods = <(MOD_LSFT|MOD_RSFT)>;
)
ZMK_MOD_MORPH(rpar_to_greaterthan,
    bindings = <&kp RPAR>, <&kp GT>;
    mods = <(MOD_LSFT|MOD_RSFT)>;
    keep-mods = <(MOD_LSFT|MOD_RSFT)>;
)
ZMK_MOD_MORPH(brk_to_brc_left,
    bindings = <&kp LBKT>, <&kp LBRC>;
    mods = <(MOD_LSFT|MOD_RSFT)>;
    keep-mods = <(MOD_LSFT|MOD_RSFT)>;
)
ZMK_MOD_MORPH(brk_to_brc_right,
    bindings = <&kp RBKT>, <&kp RBRC>;
    mods = <(MOD_LSFT|MOD_RSFT)>;
    keep-mods = <(MOD_LSFT|MOD_RSFT)>;
)

// Conditional Layers
ZMK_CONDITIONAL_LAYER(nav_win, BASE_WIN NAV, NAVW)


/* KEYMAP */

ZMK_LAYER(Base,
    // ╭──────────────┬──────────────┬──────────────┬──────────────┬──────────────╮     ╭──────────────┬──────────────┬──────────────┬──────────────┬──────────────╮
        LTL            &kp W          &kp F          &kp P          &kp B                &kp J          &kp L          &kp U          &kp Y          RTR
    // ├──────────────┼──────────────┼──────────────┼──────────────┼──────────────┤     ├──────────────┼──────────────┼──────────────┼──────────────┼──────────────┤
        &hml LCTRL R   &hml LALT S    &hml LSHIFT T  &hml LGUI H    &kp K                &kp X          &hmr RGUI N    &hmr RSHIFT A  &hmr LALT I    &hmr RCTRL O
    // ├──────────────┼──────────────┼──────────────┼──────────────┼──────────────┤     ├──────────────┼──────────────┼──────────────┼──────────────┼──────────────┤
        LBL            &kp C          &kp G          &hml RALT D    LBR                  RBL            &hmr RALT M    &comma_semi    &dot_colon     RBR
    // ╰──────────────┴──────────────┼──────────────┼──────────────┼──────────────┤     ├──────────────┼──────────────┼──────────────┼──────────────┴──────────────╯
                                      xxx            SMART_NUM      &lt_spc NAV 0        &hmt hyper E   &lt_shft ADJ 0 xxx
    //                               ╰──────────────┴──────────────┴──────────────╯     ╰──────────────┴──────────────┴──────────────╯
)

ZMK_LAYER(Base_W,
    // ╭──────────────┬──────────────┬──────────────┬──────────────┬──────────────╮     ╭──────────────┬──────────────┬──────────────┬──────────────┬──────────────╮
        ___            ___            ___            ___            ___                  ___            ___            ___            ___            ___
    // ├──────────────┼──────────────┼──────────────┼──────────────┼──────────────┤     ├──────────────┼──────────────┼──────────────┼──────────────┼──────────────┤
        &hml LGUI R    ___            ___            &hml LCTRL H   ___                  ___            &hmr RCTRL N   ___            ___            &hmr RGUI O
    // ├──────────────┼──────────────┼──────────────┼──────────────┼──────────────┤     ├──────────────┼──────────────┼──────────────┼──────────────┼──────────────┤
        ___            ___            ___            ___            ___                  ___            ___            ___            ___            ___
    // ╰──────────────┴──────────────┼──────────────┼──────────────┼──────────────┤     ├──────────────┼──────────────┼──────────────┼──────────────┴──────────────╯
                                      ___            ___            ___                  ___            ___            ___
    //                               ╰──────────────┴──────────────┴──────────────╯     ╰──────────────┴──────────────┴──────────────╯
)

ZMK_LAYER(Num,
    // ╭──────────────┬──────────────┬──────────────┬──────────────┬──────────────╮     ╭──────────────┬──────────────┬──────────────┬──────────────┬──────────────╮
        xxx            ___            ___            ___            ___                  &kp E          &kp N7         &kp N8         &kp N9         xxx
    // ├──────────────┼──────────────┼──────────────┼──────────────┼──────────────┤     ├──────────────┼──────────────┼──────────────┼──────────────┼──────────────┤
        ___            ___            ___            ___            ___                  &kp COMMA      &kp N1         &kp N2         &kp N3         &kp N0
    // ├──────────────┼──────────────┼──────────────┼──────────────┼──────────────┤     ├──────────────┼──────────────┼──────────────┼──────────────┼──────────────┤
        ___            ___            ___            ___            ___                  xxx            &kp N4         &kp N5         &kp N6         xxx
    // ╰──────────────┴──────────────┼──────────────┼──────────────┼──────────────┤     ├──────────────┼──────────────┼──────────────┼──────────────┴──────────────╯
                                      xxx            &kp K_CANCEL   ___                  &kp SPACE      &kp DOT        xxx
    //                               ╰──────────────┴──────────────┴──────────────╯     ╰──────────────┴──────────────┴──────────────╯
)

ZMK_LAYER(NumF,
    //╭──────────────┬──────────────┬──────────────┬──────────────┬──────────────╮     ╭──────────────┬──────────────┬──────────────┬──────────────┬──────────────╮
        xxx            &kp F9         &kp F8         &kp F7         &kp F10              &kp E          &kp N7         &kp N8         &kp N9         xxx
    //├──────────────┼──────────────┼──────────────┼──────────────┼──────────────┤     ├──────────────┼──────────────┼──────────────┼──────────────┼──────────────┤
        ___            &kp F3         &kp F2         &kp F1         &kp F12              &kp COMMA      &kp N1         &kp N2         &kp N3         &kp N0
    //├──────────────┼──────────────┼──────────────┼──────────────┼──────────────┤     ├──────────────┼──────────────┼──────────────┼──────────────┼──────────────┤
        xxx            &kp F6         &kp F5         &kp F4         xxx                  xxx            &kp N4         &kp N5         &kp N6         xxx
    //╰──────────────┴──────────────┼──────────────┼──────────────┼──────────────┤     ├──────────────┼──────────────┼──────────────┼──────────────┴──────────────╯
                                      xxx            xxx            ___                  &kp SPACE      &kp DOT        xxx
    //                              ╰──────────────┴──────────────┴──────────────╯     ╰──────────────┴──────────────┴──────────────╯
)

ZMK_LAYER(Nav,
    //╭─────────────────┬─────────────────┬─────────────────┬────────────────┬──────────────╮     ╭──────────────┬──────────────┬──────────────┬──────────────┬──────────────╮
        xxx               &kp LG(LEFT)      &quit             &kp LG(W)        xxx                  &screenshot    &kp LA(LEFT)   NAV_UP         &kp LA(RIGHT)  xxx
    //├─────────────────┼─────────────────┼─────────────────┼────────────────┼──────────────┤     ├──────────────┼──────────────┼──────────────┼──────────────┼──────────────┤
        &hml LCTRL LG(Z)  &hml LALT LG(X)   &hml LSHFT LG(C)  &hml LGUI LG(V)  &kp CAPS             &kp LA(DEL)    NAV_LEFT       NAV_DOWN       NAV_RIGHT      &lockscr
    //├─────────────────┼─────────────────┼─────────────────┼────────────────┼──────────────┤     ├──────────────┼──────────────┼──────────────┼──────────────┼──────────────┤
        xxx               &kp LS(TAB)       &swapper          &kp LC(TAB)      xxx                  xxx            &kp PG_DN      &key_repeat    &kp PG_UP      xxx
    //╰─────────────────┴─────────────────┼─────────────────┼────────────────┼──────────────┤     ├──────────────┼──────────────┼──────────────┼──────────────┴──────────────╯
                                            xxx               xxx               ___                  ___            xxx            xxx
    //                                    ╰─────────────────┴────────────────┴──────────────╯     ╰──────────────┴──────────────┴──────────────╯
)

ZMK_LAYER(Nav_W,
    //╭─────────────────┬─────────────────┬─────────────────┬────────────────┬──────────────╮     ╭──────────────┬──────────────┬──────────────┬──────────────┬──────────────╮
        ___               &kp LA(LEFT)      &quit_win         &kp LC(W)        ___                  &kp LG(LS(S))  &kp LC(LEFT)   NAV_UP_W       &kp LC(RIGHT)  ___
    //├─────────────────┼─────────────────┼─────────────────┼────────────────┼──────────────┤     ├──────────────┼──────────────┼──────────────┼──────────────┼──────────────┤
        &hml LGUI LC(Z)   &hml LALT LC(X)   &hml LSHFT LC(C)  &hml LCTRL LC(V) ___                  &kp LC(DEL)    NAV_LEFT_W     NAV_DOWN_W     NAV_RIGHT_W    &lockscr_win
    //├─────────────────┼─────────────────┼─────────────────┼────────────────┼──────────────┤     ├──────────────┼──────────────┼──────────────┼──────────────┼──────────────┤
        ___               ___               &swapper_win      ___              ___                  ___            ___            ___            ___            ___
    //╰─────────────────┴─────────────────┼─────────────────┼────────────────┼──────────────┤     ├──────────────┼──────────────┼──────────────┼──────────────┴──────────────╯
                                            xxx              xxx               ___                  ___            xxx            xxx
    //                                    ╰─────────────────┴────────────────┴──────────────╯     ╰──────────────┴──────────────┴──────────────╯
)

ZMK_LAYER(Game,
    //╭─────────────────┬─────────────────┬─────────────────┬────────────────┬──────────────╮     ╭──────────────┬──────────────┬──────────────┬──────────────┬──────────────╮
        xxx               &kp Q             &kp W             &kp E            &kp TAB              xxx            &kp F3         xxx            xxx            xxx
    //├─────────────────┼─────────────────┼─────────────────┼────────────────┼──────────────┤     ├──────────────┼──────────────┼──────────────┼──────────────┼──────────────┤
        &kp LSHIFT        &kp A             &kp S             &kp D            &kp F                xxx            xxx            xxx            xxx            xxx
    //├─────────────────┼─────────────────┼─────────────────┼────────────────┼──────────────┤     ├──────────────┼──────────────┼──────────────┼──────────────┼──────────────┤
        xxx               &kp N1            &kp N2            &kp N3           xxx                  xxx            xxx            xxx            xxx            xxx
    //╰─────────────────┴─────────────────┼─────────────────┼────────────────┼──────────────┤     ├──────────────┼──────────────┼──────────────┼──────────────┴──────────────╯
                                            xxx              &kp LCTRL         &kp SPACE            &tog GAME      &mo ADJ        xxx
    //                                    ╰─────────────────┴────────────────┴──────────────╯     ╰──────────────┴──────────────┴──────────────╯
)

ZMK_LAYER(Adj,
    //╭──────────────┬──────────────┬──────────────┬──────────────┬──────────────╮     ╭──────────────┬──────────────┬──────────────┬──────────────┬──────────────╮
        xxx            &to_linux      &to_pc        &to_osx        &bootloader          &bootloader    &kp C_PP       &kp C_NEXT     &kp C_PREV     xxx
    //├──────────────┼──────────────┼──────────────┼──────────────┼──────────────┤     ├──────────────┼──────────────┼──────────────┼──────────────┼──────────────┤
        BTL1                                                        &sys_reset           &sys_reset     &kp C_VOL_DN   &kp C_VOL_UP   &kp C_MUTE     xxx
    //├──────────────┼──────────────┼──────────────┼──────────────┼──────────────┤     ├──────────────┼──────────────┼──────────────┼──────────────┼──────────────┤
        BTL2                                                        xxx                  xxx            &kp C_BRI_DN   &kp C_BRI_UP   &soft_off      xxx
    //╰──────────────┴──────────────┼──────────────┼──────────────┼──────────────┤     ├──────────────┼──────────────┼──────────────┼──────────────┴──────────────╯
                                      xxx            &soft_off      xxx                  xxx            xxx            xxx
    //                              ╰──────────────┴──────────────┴──────────────╯     ╰──────────────┴──────────────┴──────────────╯
)

#ifdef MOUSE_KEYS
ZMK_LAYER(Mouse,
    //╭──────────────┬──────────────┬──────────────┬──────────────┬──────────────╮     ╭──────────────┬──────────────┬──────────────┬──────────────┬──────────────╮
        xxx            xxx            xxx            xxx            xxx                  xxx            WH_D           MS_U           WH_U           xxx
    //├──────────────┼──────────────┼──────────────┼──────────────┼──────────────┤     ├──────────────┼──────────────┼──────────────┼──────────────┼──────────────┤
        ___            ___            ___            ___            xxx                  WH_L           MS_L           MS_D           MS_R           WH_R
    //├──────────────┼──────────────┼──────────────┼──────────────┼──────────────┤     ├──────────────┼──────────────┼──────────────┼──────────────┼──────────────┤
        xxx            xxx            xxx            xxx            xxx                  xxx            &mkp MB4       &mkp MB3       &mkp MB5       xxx
    //╰──────────────┴──────────────┼──────────────┼──────────────┼──────────────┤     ├──────────────┼──────────────┼──────────────┼──────────────┴──────────────╯
                                      xxx            xxx            xxx                  &mkp MB1       &mkp MB2       xxx
    //                              ╰──────────────┴──────────────┴──────────────╯     ╰──────────────┴──────────────┴──────────────╯
)
#endif
